## meta-nodejs22/conf/layer.conf
```bitbake
BBPATH .= ":${LAYERDIR}"

BBFILES += "${LAYERDIR}/recipes-*/*/*.bb \
            ${LAYERDIR}/recipes-*/*/*.bbappend"

BBFILE_COLLECTIONS += "nodejs22"
BBFILE_PATTERN_nodejs22 = "^${LAYERDIR}/"
BBFILE_PRIORITY_nodejs22 = "50"

LAYERDEPENDS_nodejs22 = "core"
LAYERSERIES_COMPAT_nodejs22 = "kirkstone"
```

## meta-rk3399-custom/conf/machine/include/rk3399.inc
```bitbake
# Common configuration for RK3399 machines

# Bootloader
PREFERRED_PROVIDER_virtual/bootloader = "u-boot-rockchip"
UBOOT_SUFFIX = "img"
UBOOT_BINARY = "u-boot.itb"

# Kernel
PREFERRED_PROVIDER_virtual/kernel = "linux-mainline"
PREFERRED_VERSION_linux-mainline = "6.1.163"

# Machine architecture
TARGET_ARCH = "aarch64"
TUNE_FEATURES = "aarch64"

# Boot device
BOOT_DEVICE = "mmc"

# Image generation
IMAGE_FSTYPES += "wic wic.bmap"
WKS_FILE = "rk3399-sdimage.wks.in"

# Rockchip specific
RK3399_SOC = "rk3399"
RK3399_DDR_BLOB = "rk33/rk3399_ddr_933MHz_v1.25.bin"
RK3399_MINILOADER_BLOB = "rk33/rk3399_miniloader_v1.26.bin"
RK3399_BL31_BLOB = "rk33/rk3399_bl31_v1.35.elf"

# U-Boot environment
UBOOT_ENV_SIZE = "0x20000"
```

## meta-rk3399-custom/recipes-kernel/linux/linux-mainline/defconfig
```kconfig
# RK3399 Complete Kernel Configuration
# This replaces the fragment approach for better control

# ARM64 Architecture
CONFIG_ARM64=y
CONFIG_SMP=y
CONFIG_HOTPLUG_CPU=y
CONFIG_PREEMPT=y
CONFIG_PREEMPT_VOLUNTARY=y

# System V IPC - required by LinuxCNC uspace RTAPI
CONFIG_SYSVIPC=y
CONFIG_SYSVIPC_SYSCTL=y
CONFIG_SYSV_SHM=y
CONFIG_SYSV_SEM=y
CONFIG_SYSV_MSG=y

# Disable EFI STUB to generate standard ARM64 Image for U-Boot
# CONFIG_EFI_STUB is not set
# CONFIG_EFI is not set

# CPU frequency scaling
CONFIG_CPU_FREQ=y
CONFIG_CPU_FREQ_GOV_POWERSAVE=y
CONFIG_CPU_FREQ_GOV_USERSPACE=y
CONFIG_CPU_FREQ_GOV_ONDEMAND=y
CONFIG_CPU_FREQ_GOV_CONSERVATIVE=y
# CONFIG_CPUFREQ_DT is not set
# CONFIG_ARM_RK3399_CPUFREQ is not set

# Rockchip specific
CONFIG_ARCH_ROCKCHIP=y
CONFIG_CPU_RK3399=y
CONFIG_PINCTRL_ROCKCHIP=y
CONFIG_GPIO_ROCKCHIP=y
CONFIG_CLK_ROCKCHIP=y
CONFIG_ROCKCHIP_IOMMU=y
CONFIG_ROCKCHIP_PM_DOMAINS=y
CONFIG_ROCKCHIP_PMU=y
CONFIG_MFD_ROCKCHIP_PMU=y
CONFIG_MFD_RK808=y
CONFIG_REGULATOR=y
CONFIG_REGULATOR_RK808=y
CONFIG_POWER_AVS=y
CONFIG_POWER_RESET=y
CONFIG_POWER_RESET_SYSCON=y

# Serial console - CRITICAL for debugging
CONFIG_SERIAL_8250=y
CONFIG_SERIAL_8250_CONSOLE=y
CONFIG_SERIAL_8250_DW=y
CONFIG_SERIAL_EARLYCON=y
CONFIG_SERIAL_EARLYCON_ARM_SEMIHOST=y
CONFIG_EARLY_PRINTK=y
CONFIG_EARLYCON=y

# I2C debugging and stability fixes
CONFIG_I2C=y
CONFIG_I2C_CHARDEV=y
CONFIG_I2C_DEBUG_CORE=y
CONFIG_I2C_DEBUG_ALGO=y
CONFIG_I2C_DEBUG_BUS=y
CONFIG_I2C_RK3X=y
CONFIG_I2C_DESIGNWARE_PLATFORM=y
# 增加I2C稳定性配置
CONFIG_I2C_SLAVE=y
CONFIG_I2C_ALGOBIT=y
CONFIG_I2C_HELPER_AUTO=y
CONFIG_I2C_BOARDINFO=y
CONFIG_I2C_COMPAT=y

# Regulator support - CRITICAL for power management
CONFIG_REGULATOR=y
CONFIG_REGULATOR_FIXED=y
CONFIG_REGULATOR_FIXED_VOLTAGE=y
CONFIG_REGULATOR_DEBUG=y
CONFIG_REGULATOR_USERSPACE_CONSUMER=y
CONFIG_REGULATOR_ANATOP=y
CONFIG_REGULATOR_VIRTUAL=y
CONFIG_OF_REGULATOR=y
CONFIG_REGULATOR_GPIO=y
CONFIG_REGULATOR_RK808=y
CONFIG_REGULATOR_FAN53555=y
# 增强调节器稳定性
CONFIG_REGULATOR_ACT8865=y
CONFIG_REGULATOR_AD5398=y
CONFIG_REGULATOR_DA9210=y
CONFIG_REGULATOR_DA9211=y

# Storage - MMC/SD/eMMC support - CRITICAL for root filesystem
CONFIG_MMC=y
CONFIG_PWRSEQ_EMMC=y
CONFIG_PWRSEQ_SIMPLE=y
CONFIG_MMC_BLOCK=y
CONFIG_MMC_BLOCK_MINORS=32
# SDHCI (for eMMC)
CONFIG_MMC_SDHCI=y
CONFIG_MMC_SDHCI_PLTFM=y
CONFIG_MMC_SDHCI_OF_ARASAN=y
# DW MMC (for SD card)
CONFIG_MMC_DW=y
CONFIG_MMC_DW_PLTFM=y
CONFIG_MMC_DW_ROCKCHIP=y
# MMC Debug Support
CONFIG_MMC_DEBUG=y
CONFIG_MMC_TRACE=y
CONFIG_MMC_UNSAFE_RESUME=y
CONFIG_MMC_CLKGATE=y
# 增强MMC稳定性
CONFIG_MMC_PARANOID_SD_INIT=y
CONFIG_MMC_BLOCK_BOUNCE=y

# I2C support (required for some drivers)
CONFIG_I2C=y
CONFIG_I2C_BOARDINFO=y
CONFIG_I2C_COMPAT=y
CONFIG_I2C_CHARDEV=y
CONFIG_I2C_HELPER_AUTO=y
CONFIG_I2C_ALGOBIT=y

# USB
CONFIG_USB=y
CONFIG_USB_SUPPORT=y
CONFIG_USB_DWC3=y
CONFIG_USB_DWC3_OF_SIMPLE=y
CONFIG_USB_GADGET=y
CONFIG_USB_STORAGE=y

# USB networking (host mode for phone USB tethering)
CONFIG_USB_NET_DRIVERS=y
CONFIG_USB_USBNET=y
CONFIG_USB_NET_RNDIS_HOST=y
CONFIG_USB_NET_CDCETHER=y
CONFIG_USB_NET_CDC_NCM=y

# Network - Basic networking support
CONFIG_NET=y
CONFIG_PACKET=y
CONFIG_UNIX=y
CONFIG_UNIX_SCM=y

# IPv4 networking - CRITICAL for socket support
CONFIG_INET=y
CONFIG_IP_MULTICAST=y
CONFIG_IP_PNP=y
CONFIG_IP_PNP_DHCP=y
CONFIG_IP_PNP_BOOTP=y
CONFIG_IP_PNP_RARP=y
CONFIG_SYN_COOKIES=y
CONFIG_INET_TCP_DIAG=y
CONFIG_INET_UDP_DIAG=y
CONFIG_TCP_CONG_CUBIC=y
CONFIG_DEFAULT_TCP_CONG="cubic"

# Network devices
CONFIG_NETDEVICES=y
CONFIG_ETHERNET=y
CONFIG_NET_VENDOR_ROCKCHIP=y
CONFIG_STMMAC_ETH=y
CONFIG_DWMAC_ROCKCHIP=y

# Filesystems
CONFIG_ROOTFS=y
CONFIG_EXT4_FS=y
CONFIG_EXT4_FS_POSIX_ACL=y
CONFIG_EXT4_FS_SECURITY=y
CONFIG_EXT4_USE_FOR_EXT4=y
CONFIG_VFAT_FS=y
CONFIG_FAT_DEFAULT_UTF8=y
CONFIG_FAT_FS=y

# Device tree
CONFIG_OF=y
CONFIG_OF_FLATTREE=y
CONFIG_OF_EARLY_FLATTREE=y
CONFIG_OF_KOBJ=y
CONFIG_OF_DYNAMIC=y
CONFIG_OF_OVERLAY=y
# CONFIG_OF_UNITTEST is not set
CONFIG_OF_DEBUG=y

# Power management
CONFIG_PM=y
CONFIG_PM_SLEEP=y
CONFIG_SUSPEND=y
CONFIG_PM_DEBUG=y
# CONFIG_PM_ADVANCED_DEBUG is not set
# Regulator support (required for MMC power supply)
CONFIG_REGULATOR=y
CONFIG_REGULATOR_FIXED=y
CONFIG_REGULATOR_FIXED_VOLTAGE=y
CONFIG_REGULATOR_PWM=y
CONFIG_REGULATOR_DEBUG=y
# Clock management
CONFIG_COMMON_CLK=y
CONFIG_COMMON_CLK_DEBUG=y
CONFIG_CLK_DEBUG=y

# Device management - CRITICAL for /dev directory creation
CONFIG_DEVTMPFS=y
CONFIG_DEVTMPFS_MOUNT=y
CONFIG_TMPFS=y
CONFIG_TMPFS_POSIX_ACL=y

# Uevent support for device node creation
CONFIG_UEVENT_HELPER=y
CONFIG_UEVENT_HELPER_PATH="/sbin/hotplug"

# Block device support
CONFIG_BLOCK=y
CONFIG_BLOCK_LEGACY_AUTOLOAD=y
CONFIG_BLK_DEV=y
CONFIG_BLK_DEV_SD=y
CONFIG_SDIO=y
CONFIG_MMC_SDIO=y

# System filesystems
CONFIG_SYSFS=y
CONFIG_SYSFS_SYSCALL=y

# Character devices
CONFIG_TTY=y
CONFIG_VT=y
CONFIG_VT_CONSOLE=y

# Input devices - required for USB mouse support
CONFIG_INPUT=y
CONFIG_INPUT_EVDEV=y
CONFIG_INPUT_MOUSE=y

# HID stack for USB peripherals
CONFIG_HID=y
CONFIG_HID_GENERIC=y
CONFIG_HID_RAZER=m
CONFIG_USB_HID=y

# Console device - CRITICAL for initial console
CONFIG_VT_CONSOLE=y
CONFIG_HW_CONSOLE=y
CONFIG_CONSOLE_TRANSLATIONS=y
CONFIG_VT_HW_CONSOLE_BINDING=y

# Initramfs support
CONFIG_BLK_DEV_INITRD=y
CONFIG_INITRAMFS_SOURCE=y

# Kernel debugging
CONFIG_DEBUG_KERNEL=y
CONFIG_DEBUG_INFO=y
CONFIG_DEBUG_BUGVERBOSE=y
CONFIG_DEBUG_FS=y
CONFIG_EXT4_DEBUG=y

# Partition support
CONFIG_PARTITION_ADVANCED=y
CONFIG_EFI_PARTITION=y
CONFIG_MSDOS_PARTITION=y
CONFIG_OF_PARTITION=y

# Disk and partition drivers
CONFIG_GPT_PARTITION=y
CONFIG_MAC_PARTITION=y
CONFIG_MSDOS_PARTITION=y
CONFIG_EFI_PARTITION=y

# SCSI and storage drivers
CONFIG_SCSI=y
CONFIG_SCSI_COMMON=y
CONFIG_BLK_DEV_SD=y
CONFIG_SCSI_SCAN_ASYNC=y

# Enhanced debugging
CONFIG_DYNAMIC_DEBUG=y
CONFIG_DEBUG_DRIVER=y
CONFIG_DEBUG_DEVRES=y

# Clock and Timer Support
CONFIG_COMMON_CLK=y
CONFIG_COMMON_CLK_RK808=y
CONFIG_CLKSRC_MMIO=y
CONFIG_ARM_GLOBAL_TIMER=y
CONFIG_CLKDEV_LOOKUP=y
CONFIG_HAVE_CLK_PREPARE=y
CONFIG_COMMON_CLK=y

# GPIO Support
CONFIG_GPIOLIB=y
CONFIG_GPIO_SYSFS=y
CONFIG_GPIO_GENERIC=y
CONFIG_GPIO_GENERIC_PLATFORM=y
CONFIG_OF_GPIO=y
CONFIG_GPIO_ROCKCHIP=y

# Power Management Enhanced
CONFIG_PM=y
CONFIG_PM_SLEEP=y
CONFIG_PM_SLEEP_SMP=y
CONFIG_PM_RUNTIME=y
CONFIG_PM_OPP=y
CONFIG_PM_CLK=y
CONFIG_PM_GENERIC_DOMAINS=y
CONFIG_PM_GENERIC_DOMAINS_OF=y
CONFIG_POWER_SUPPLY=y
CONFIG_POWER_SUPPLY_HWMON=y
CONFIG_BATTERY_SBS=y
CONFIG_BATTERY_BQ27XXX=y

# Network Support Enhanced
CONFIG_NETDEVICES=y
CONFIG_ETHERNET=y
CONFIG_NET_VENDOR_ROCKCHIP=y
CONFIG_ROCKCHIP_PHY=y
CONFIG_STMMAC_ETH=y
CONFIG_STMMAC_PLATFORM=y
CONFIG_DWMAC_ROCKCHIP=y
CONFIG_PHYLIB=y
CONFIG_PHY_ROCKCHIP_INNO_USB2=y
CONFIG_PHY_ROCKCHIP_PCIE=y
CONFIG_PHY_ROCKCHIP_TYPEC=y
CONFIG_PHY_ROCKCHIP_EMMC=y

# USB Support Enhanced
CONFIG_USB=y
CONFIG_USB_MON=y
CONFIG_USB_XHCI_HCD=y
CONFIG_USB_EHCI_HCD=y
CONFIG_USB_EHCI_ROOT_HUB_TT=y
CONFIG_USB_EHCI_HCD_PLATFORM=y
CONFIG_USB_OHCI_HCD=y
CONFIG_USB_OHCI_HCD_PLATFORM=y
CONFIG_USB_STORAGE=y
CONFIG_USB_STORAGE_DEBUG=y
CONFIG_USB_DWC3=y
CONFIG_USB_DWC3_OF_SIMPLE=y
CONFIG_USB_GADGET=y

# DRM (Direct Rendering Manager) and Display Support - CRITICAL for HDMI output
CONFIG_DRM=y
CONFIG_DRM_KMS_HELPER=y
CONFIG_DRM_FBDEV_EMULATION=y
CONFIG_DRM_FBDEV_OVERALLOC=100
CONFIG_DRM_LOAD_EDID_FIRMWARE=y
CONFIG_DRM_DP_AUX_CHARDEV=y
CONFIG_DRM_DISPLAY_HELPER=y
CONFIG_DRM_DISPLAY_DP_HELPER=y
CONFIG_DRM_DISPLAY_HDMI_HELPER=y
CONFIG_DRM_GEM_SHMEM_HELPER=y
CONFIG_DRM_GEM_DMA_HELPER=y

# Rockchip DRM driver
CONFIG_DRM_ROCKCHIP=y
CONFIG_ROCKCHIP_ANALOGIX_DP=y
CONFIG_ROCKCHIP_CDN_DP=y
CONFIG_ROCKCHIP_DW_HDMI=y
CONFIG_ROCKCHIP_DW_MIPI_DSI=y
CONFIG_ROCKCHIP_INNO_HDMI_PHY=y
CONFIG_ROCKCHIP_LVDS=y
CONFIG_ROCKCHIP_RGB=y
CONFIG_ROCKCHIP_VOP=y
CONFIG_ROCKCHIP_VOP2=y

# Display panels
CONFIG_DRM_PANEL=y
CONFIG_DRM_PANEL_SIMPLE=y
CONFIG_DRM_PANEL_EDP=y

# Framebuffer support (fallback)
CONFIG_FB=y
CONFIG_FB_CMDLINE=y
CONFIG_FB_DEFERRED_IO=y
CONFIG_FB_SYS_FOPS=y
CONFIG_FB_SYS_COPYAREA=y
CONFIG_FB_SYS_FILLRECT=y
CONFIG_FB_SYS_IMAGEBLIT=y
CONFIG_FB_BACKLIGHT=y
CONFIG_BACKLIGHT_CLASS_DEVICE=y
CONFIG_BACKLIGHT_GENERIC=y

# Mali GPU support (Panfrost)
CONFIG_DRM_PANFROST=y
CONFIG_DRM_PANFROST_FORCE_MMU=y
```

## meta-rk3399-custom/recipes-kernel/linux/linux-rockchip/defconfig
```kconfig
# RK3399 Complete Kernel Configuration
# This replaces the fragment approach for better control

# ARM64 Architecture
CONFIG_ARM64=y
CONFIG_SMP=y
CONFIG_HOTPLUG_CPU=y
CONFIG_PREEMPT=y
CONFIG_PREEMPT_VOLUNTARY=y

# Disable EFI STUB to generate standard ARM64 Image for U-Boot
# CONFIG_EFI_STUB is not set
# CONFIG_EFI is not set

# CPU frequency scaling
CONFIG_CPU_FREQ=y
CONFIG_CPU_FREQ_GOV_POWERSAVE=y
CONFIG_CPU_FREQ_GOV_USERSPACE=y
CONFIG_CPU_FREQ_GOV_ONDEMAND=y
CONFIG_CPU_FREQ_GOV_CONSERVATIVE=y
# CONFIG_CPUFREQ_DT is not set
# CONFIG_ARM_RK3399_CPUFREQ is not set

# Rockchip specific
CONFIG_ARCH_ROCKCHIP=y
CONFIG_CPU_RK3399=y
CONFIG_PINCTRL_ROCKCHIP=y
CONFIG_GPIO_ROCKCHIP=y
CONFIG_CLK_ROCKCHIP=y
CONFIG_ROCKCHIP_IOMMU=y
CONFIG_ROCKCHIP_PM_DOMAINS=y
CONFIG_ROCKCHIP_PMU=y
CONFIG_MFD_ROCKCHIP_PMU=y
CONFIG_MFD_RK808=y
CONFIG_REGULATOR=y
CONFIG_REGULATOR_RK808=y
CONFIG_POWER_AVS=y
CONFIG_POWER_RESET=y
CONFIG_POWER_RESET_SYSCON=y

# Serial console - CRITICAL for debugging
CONFIG_SERIAL_8250=y
CONFIG_SERIAL_8250_CONSOLE=y
CONFIG_SERIAL_8250_DW=y
CONFIG_SERIAL_EARLYCON=y
CONFIG_SERIAL_EARLYCON_ARM_SEMIHOST=y
CONFIG_EARLY_PRINTK=y
CONFIG_EARLYCON=y

# I2C debugging and stability fixes
CONFIG_I2C=y
CONFIG_I2C_CHARDEV=y
CONFIG_I2C_DEBUG_CORE=y
CONFIG_I2C_DEBUG_ALGO=y
CONFIG_I2C_DEBUG_BUS=y
CONFIG_I2C_RK3X=y
CONFIG_I2C_DESIGNWARE_PLATFORM=y
# 增加I2C稳定性配置
CONFIG_I2C_SLAVE=y
CONFIG_I2C_ALGOBIT=y
CONFIG_I2C_HELPER_AUTO=y
CONFIG_I2C_BOARDINFO=y
CONFIG_I2C_COMPAT=y

# Regulator support - CRITICAL for power management
CONFIG_REGULATOR=y
CONFIG_REGULATOR_FIXED=y
CONFIG_REGULATOR_FIXED_VOLTAGE=y
CONFIG_REGULATOR_DEBUG=y
CONFIG_REGULATOR_USERSPACE_CONSUMER=y
CONFIG_REGULATOR_ANATOP=y
CONFIG_REGULATOR_VIRTUAL=y
CONFIG_OF_REGULATOR=y
CONFIG_REGULATOR_GPIO=y
CONFIG_REGULATOR_RK808=y
CONFIG_REGULATOR_FAN53555=y
# 增强调节器稳定性
CONFIG_REGULATOR_ACT8865=y
CONFIG_REGULATOR_AD5398=y
CONFIG_REGULATOR_DA9210=y
CONFIG_REGULATOR_DA9211=y

# Storage - MMC/SD/eMMC support - CRITICAL for root filesystem
CONFIG_MMC=y
CONFIG_PWRSEQ_EMMC=y
CONFIG_PWRSEQ_SIMPLE=y
CONFIG_MMC_BLOCK=y
CONFIG_MMC_BLOCK_MINORS=32
# SDHCI (for eMMC)
CONFIG_MMC_SDHCI=y
CONFIG_MMC_SDHCI_PLTFM=y
CONFIG_MMC_SDHCI_OF_ARASAN=y
# DW MMC (for SD card)
CONFIG_MMC_DW=y
CONFIG_MMC_DW_PLTFM=y
CONFIG_MMC_DW_ROCKCHIP=y
# MMC Debug Support
CONFIG_MMC_DEBUG=y
CONFIG_MMC_TRACE=y
CONFIG_MMC_UNSAFE_RESUME=y
CONFIG_MMC_CLKGATE=y
# 增强MMC稳定性
CONFIG_MMC_PARANOID_SD_INIT=y
CONFIG_MMC_BLOCK_BOUNCE=y

# I2C support (required for some drivers)
CONFIG_I2C=y
CONFIG_I2C_BOARDINFO=y
CONFIG_I2C_COMPAT=y
CONFIG_I2C_CHARDEV=y
CONFIG_I2C_HELPER_AUTO=y
CONFIG_I2C_ALGOBIT=y

# USB
CONFIG_USB=y
CONFIG_USB_SUPPORT=y
CONFIG_USB_DWC3=y
CONFIG_USB_DWC3_OF_SIMPLE=y
CONFIG_USB_GADGET=y
CONFIG_USB_STORAGE=y

# Network
CONFIG_NET=y
CONFIG_INET=y
CONFIG_IP_MULTICAST=y
CONFIG_IP_PNP=y
CONFIG_IP_PNP_DHCP=y
CONFIG_NETDEVICES=y
CONFIG_ETHERNET=y
CONFIG_NET_VENDOR_ROCKCHIP=y
CONFIG_STMMAC_ETH=y
CONFIG_DWMAC_ROCKCHIP=y

# Filesystems
CONFIG_ROOTFS=y
CONFIG_EXT4_FS=y
CONFIG_EXT4_FS_POSIX_ACL=y
CONFIG_EXT4_FS_SECURITY=y
CONFIG_EXT4_USE_FOR_EXT4=y
CONFIG_VFAT_FS=y
CONFIG_FAT_DEFAULT_UTF8=y
CONFIG_FAT_FS=y

# Device tree
CONFIG_OF=y
CONFIG_OF_FLATTREE=y
CONFIG_OF_EARLY_FLATTREE=y
CONFIG_OF_KOBJ=y
CONFIG_OF_DYNAMIC=y
CONFIG_OF_OVERLAY=y
CONFIG_OF_UNITTEST=y
CONFIG_OF_DEBUG=y

# Power management
CONFIG_PM=y
CONFIG_PM_SLEEP=y
CONFIG_SUSPEND=y
CONFIG_PM_DEBUG=y
CONFIG_PM_ADVANCED_DEBUG=y
# Regulator support (required for MMC power supply)
CONFIG_REGULATOR=y
CONFIG_REGULATOR_FIXED=y
CONFIG_REGULATOR_FIXED_VOLTAGE=y
CONFIG_REGULATOR_PWM=y
CONFIG_REGULATOR_DEBUG=y
# Clock management
CONFIG_COMMON_CLK=y
CONFIG_COMMON_CLK_DEBUG=y
CONFIG_CLK_DEBUG=y

# Device management - CRITICAL for /dev directory creation
CONFIG_DEVTMPFS=y
CONFIG_DEVTMPFS_MOUNT=y
CONFIG_TMPFS=y
CONFIG_TMPFS_POSIX_ACL=y

# Uevent support for device node creation
CONFIG_UEVENT_HELPER=y
CONFIG_UEVENT_HELPER_PATH="/sbin/hotplug"

# Block device support
CONFIG_BLOCK=y
CONFIG_BLOCK_LEGACY_AUTOLOAD=y
CONFIG_BLK_DEV=y
CONFIG_BLK_DEV_SD=y
CONFIG_SDIO=y
CONFIG_MMC_SDIO=y

# System filesystems
CONFIG_SYSFS=y
CONFIG_SYSFS_SYSCALL=y

# Character devices
CONFIG_TTY=y
CONFIG_VT=y
CONFIG_VT_CONSOLE=y

# Console device - CRITICAL for initial console
CONFIG_VT_CONSOLE=y
CONFIG_HW_CONSOLE=y
CONFIG_CONSOLE_TRANSLATIONS=y
CONFIG_VT_HW_CONSOLE_BINDING=y

# Initramfs support
CONFIG_BLK_DEV_INITRD=y
CONFIG_INITRAMFS_SOURCE=y

# Kernel debugging
CONFIG_DEBUG_KERNEL=y
CONFIG_DEBUG_INFO=y
CONFIG_DEBUG_BUGVERBOSE=y
CONFIG_DEBUG_FS=y
CONFIG_EXT4_DEBUG=y

# Partition support
CONFIG_PARTITION_ADVANCED=y
CONFIG_EFI_PARTITION=y
CONFIG_MSDOS_PARTITION=y
CONFIG_OF_PARTITION=y

# Disk and partition drivers
CONFIG_GPT_PARTITION=y
CONFIG_MAC_PARTITION=y
CONFIG_MSDOS_PARTITION=y
CONFIG_EFI_PARTITION=y

# SCSI and storage drivers
CONFIG_SCSI=y
CONFIG_SCSI_COMMON=y
CONFIG_BLK_DEV_SD=y
CONFIG_SCSI_SCAN_ASYNC=y

# Enhanced debugging
CONFIG_DYNAMIC_DEBUG=y
CONFIG_DEBUG_DRIVER=y
CONFIG_DEBUG_DEVRES=y

# Clock and Timer Support
CONFIG_COMMON_CLK=y
CONFIG_COMMON_CLK_RK808=y
CONFIG_CLKSRC_MMIO=y
CONFIG_ARM_GLOBAL_TIMER=y
CONFIG_CLKDEV_LOOKUP=y
CONFIG_HAVE_CLK_PREPARE=y
CONFIG_COMMON_CLK=y

# GPIO Support
CONFIG_GPIOLIB=y
CONFIG_GPIO_SYSFS=y
CONFIG_GPIO_GENERIC=y
CONFIG_GPIO_GENERIC_PLATFORM=y
CONFIG_OF_GPIO=y
CONFIG_GPIO_ROCKCHIP=y

# Power Management Enhanced
CONFIG_PM=y
CONFIG_PM_SLEEP=y
CONFIG_PM_SLEEP_SMP=y
CONFIG_PM_RUNTIME=y
CONFIG_PM_OPP=y
CONFIG_PM_CLK=y
CONFIG_PM_GENERIC_DOMAINS=y
CONFIG_PM_GENERIC_DOMAINS_OF=y
CONFIG_POWER_SUPPLY=y
CONFIG_POWER_SUPPLY_HWMON=y
CONFIG_BATTERY_SBS=y
CONFIG_BATTERY_BQ27XXX=y

# Network Support Enhanced
CONFIG_NETDEVICES=y
CONFIG_ETHERNET=y
CONFIG_NET_VENDOR_ROCKCHIP=y
CONFIG_ROCKCHIP_PHY=y
CONFIG_STMMAC_ETH=y
CONFIG_STMMAC_PLATFORM=y
CONFIG_DWMAC_ROCKCHIP=y
CONFIG_PHYLIB=y
CONFIG_PHY_ROCKCHIP_INNO_USB2=y
CONFIG_PHY_ROCKCHIP_PCIE=y
CONFIG_PHY_ROCKCHIP_TYPEC=y
CONFIG_PHY_ROCKCHIP_EMMC=y

# USB Support Enhanced
CONFIG_USB=y
CONFIG_USB_MON=y
CONFIG_USB_XHCI_HCD=y
CONFIG_USB_EHCI_HCD=y
CONFIG_USB_EHCI_ROOT_HUB_TT=y
CONFIG_USB_EHCI_HCD_PLATFORM=y
CONFIG_USB_OHCI_HCD=y
CONFIG_USB_OHCI_HCD_PLATFORM=y
CONFIG_USB_STORAGE=y
CONFIG_USB_STORAGE_DEBUG=y
CONFIG_USB_DWC3=y
CONFIG_USB_DWC3_OF_SIMPLE=y
CONFIG_USB_GADGET=y
```
